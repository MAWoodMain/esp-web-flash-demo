## sample.yaml
```
# This file is provided so that the application can be compiled using Twister,
# the Zephyr testing tool. In this file, multiple combinations can be specified,
# so that you can easily test all of them locally or in CI.
sample:
  description: Example ESP Zephyr project with web flasher
  name: esp-web-flash-demo
common:
  build_only: true
  integration_platforms:
    - heltec_wireless_stick_lite_v3_procpu
tests:
  app.default: {}
  app.debug:
    extra_overlay_confs:
      - debug.conf
```

## prj.conf
```kconfig
# Copyright (c) 2021 Nordic Semiconductor ASA
# SPDX-License-Identifier: Apache-2.0
#
# This file contains selected Kconfig options for the application.
CONFIG_LOG=y
```

## boards/heltec_wireless_stick_lite_v3_procpu.overlay
```dts
/ {
	example_sensor: example-sensor {
		compatible = "zephyr,example-sensor";
		input-gpios = <&gpio0 0 (GPIO_PULL_UP | GPIO_ACTIVE_LOW)>;
	};

	blink_led: blink-led {
		compatible = "blink-gpio-led";
		led-gpios = <&gpio0 32 GPIO_ACTIVE_HIGH>;
		blink-period-ms = <1000>;
	};
};
```

## src/main.c
```c
/*
 * Copyright (c) 2021 Nordic Semiconductor ASA
 * SPDX-License-Identifier: Apache-2.0
 */

#include <zephyr/kernel.h>
#include <zephyr/logging/log.h>

#include <app_version.h>

LOG_MODULE_REGISTER(main, CONFIG_APP_LOG_LEVEL);

int main(void)
{

	printk("Zephyr Example Application %s\n", APP_VERSION_STRING);

	return 0;
}
```
